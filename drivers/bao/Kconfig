## drivers/bao/Kconfig
```kconfig
config BAO_HYPERCALLS
	tristate "Bao hypercalls support"

	help
	  This implements an interface to communicate between bao and hosted guests.
```

## drivers/smmu_dma_driver/Kconfig
```kconfig
config SMMU_DMA_DRIVER
	tristate "SMMU DMA alloc support"

	help
	  This implements a driver to allocate DMU buffers to test SMMU caches.
```
